## components/rapidjson/Kconfig
```kconfig
# rapidjson
menu "RapidJSON"
    config RAPIDJSON_ALLOCATOR_DEFAULT_CHUNK_CAPACITY
        int "User-defined kDefaultChunkCapacity definition"
        default 1024
        help
            User can define this as any size that is a power of 2.

    config RAPIDJSON_VALUE_DEFAULT_ARRAY_CAPACITY
        int "User defined kDefaultArrayCapacity value"
        default 8
        help
            User can define this as any natural number.

    config RAPIDJSON_VALUE_DEFAULT_OBJECT_CAPACITY
        int "User defined kDefaultObjectCapacity value"
        default 8
        help
            User can define this as any natural number.
endmenu
```

## main/Kconfig.projbuild
```kconfig
menu "Application config"
    config APP_DEVICE_NAME
        string "RainMaker device name"
        default "BenQ Projector"

    config APP_DEVICE_TYPE
        string "RainMaker device type"
        default "esp.device.projector"

    config APP_PROJ_UART_NUM
        int "Projector uart number"
        default 2

    config APP_PROJ_UART_BAUD
        int "Projector serial baud"
        default 115200

    config APP_PROJ_UART_TX_PIN
        int "Serial TX pin"
        default 19

    config APP_PROJ_UART_RX_PIN
        int "Serial RX pin"
        default 18
endmenu
```

## sdkconfig.defaults
```kconfig
# Custom partition table
CONFIG_ESPTOOLPY_FLASHSIZE_4MB=y
CONFIG_PARTITION_TABLE_CUSTOM=y
CONFIG_PARTITION_TABLE_CUSTOM_FILENAME="partitions.csv"

# Enable support for power management
CONFIG_PM_ENABLE=y
CONFIG_PM_DFS_INIT_AUTO=y
CONFIG_FREERTOS_USE_TICKLESS_IDLE=y
CONFIG_ESP32_DEFAULT_CPU_FREQ_240=y

# Disable insecure TLS
CONFIG_MBEDTLS_SSL_PROTO_TLS1=n
CONFIG_MBEDTLS_SSL_PROTO_TLS1_1=n

# WiFi provisioning
CONFIG_APP_WIFI_PROV_TYPE_BLE=y
CONFIG_APP_WIFI_PROV_TYPE_SOFT_AP=n

# BLE for provisioning
CONFIG_BT_ENABLED=y
CONFIG_BTDM_CTRL_MODE_BLE_ONLY=y
CONFIG_BTDM_CTRL_MODE_BR_EDR_ONLY=n
CONFIG_BTDM_CTRL_MODE_BTDM=n
CONFIG_BT_NIMBLE_ENABLED=y

# WiFi reconfigure timeout
CONFIG_DOUBLE_RESET_DEFAULT_TIMEOUT=5000

# Status LED
CONFIG_STATUS_LED_DEFAULT_ENABLE=y
CONFIG_STATUS_LED_DEFAULT_GPIO=0
CONFIG_STATUS_LED_DEFAULT_ON=0

# RainMaker
CONFIG_ESP_RMAKER_DEF_TIMEZONE="Europe/Prague"
CONFIG_ESP_RMAKER_SNTP_SERVER_NAME="pool.ntp.org"
```
